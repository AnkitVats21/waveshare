## components/nexus_db/Kconfig
```kconfig
menu "nexus_db"

config NEXUS_DB_STRESS_TEST
    bool "Power-loss stress test at boot"
    default n
    help
        Test build only. When /sdcard/db/stress.run exists (it holds the
        number of rounds), each boot checks /sdcard/db/stress.ndb against the
        writes acknowledged before the last reset, then writes until an
        esp_restart at a random moment. Results go to /sdcard/db/stress.log.
        The random resets interrupt SD writes, so leave this off otherwise.

endmenu
```

## components/sd_storage/Kconfig
```kconfig
menu "SD storage"

    config SD_STORAGE_DMA_BUFFER_SIZE
        int "Persistent SDMMC DMA bounce buffer (bytes)"
        range 0 32768
        default 0
        help
            Internal DMA-capable buffer handed to the SDMMC driver at mount
            (sdmmc_host_t::dma_aligned_buffer). The driver copies every
            transfer to or from a PSRAM buffer through it. With 0 the driver
            instead mallocs and frees a buffer (up to 8 KB) on every such call.
            Off by default: measured 2026-09-26, 8 KB here cost 8 KB of idle
            internal RAM and did not raise the playback low-water mark
            (10.6 KB vs 11.3 KB without it). Must be a multiple of 512.

endmenu
```

## main/Kconfig.projbuild
```kconfig
menu "Waveshare Audio Development Board Config"

menu "Board Pin Defaults"

config WAVESHARE_BOARD_I2C_SCL_GPIO
    int "Board I2C SCL GPIO"
    range 0 48
    default 10

config WAVESHARE_BOARD_I2C_SDA_GPIO
    int "Board I2C SDA GPIO"
    range 0 48
    default 11

config WAVESHARE_BOARD_I2S_MCLK_GPIO
    int "Board I2S MCLK GPIO"
    range 0 48
    default 12

config WAVESHARE_BOARD_I2S_BCLK_GPIO
    int "Board I2S BCLK GPIO"
    range 0 48
    default 13

config WAVESHARE_BOARD_I2S_LRCK_GPIO
    int "Board I2S LRCK GPIO"
    range 0 48
    default 14

config WAVESHARE_BOARD_I2S_DOUT_GPIO
    int "Board I2S DOUT GPIO"
    range 0 48
    default 16

config WAVESHARE_BOARD_I2S_DIN_GPIO
    int "Board I2S DIN GPIO"
    range 0 48
    default 15

config WAVESHARE_BOARD_RGB_LED_GPIO
    int "Board RGB LED GPIO"
    range 0 48
    default 38

config WAVESHARE_BOARD_SDMMC_CLK_GPIO
    int "Board SDMMC CLK GPIO"
    range 0 48
    default 40

config WAVESHARE_BOARD_SDMMC_D0_GPIO
    int "Board SDMMC D0 GPIO"
    range 0 48
    default 41

config WAVESHARE_BOARD_SDMMC_CMD_GPIO
    int "Board SDMMC CMD GPIO"
    range 0 48
    default 42

config WAVESHARE_BOARD_SD_CD_EXIO
    int "Board SD card detect EXIO index"
    range 0 15
    default 3

config WAVESHARE_BOARD_PA_EN_EXIO
    int "Board PA enable EXIO index"
    range 0 15
    default 8

config WAVESHARE_BOARD_KEY1_EXIO
    int "Board KEY1 EXIO index"
    range 0 15
    default 9

config WAVESHARE_BOARD_KEY2_EXIO
    int "Board KEY2 EXIO index"
    range 0 15
    default 10

config WAVESHARE_BOARD_KEY3_EXIO
    int "Board KEY3 EXIO index"
    range 0 15
    default 11

endmenu

menu "Hardware Services"

config WAVESHARE_HW_I2C_ENABLE
    bool "Enable board hardware services"
    default y

config WAVESHARE_HW_I2C_PORT
    int "Hardware I2C port"
    depends on WAVESHARE_HW_I2C_ENABLE
    range 0 1
    default 0

config WAVESHARE_HW_I2C_FREQ_HZ
    int "Hardware I2C clock (Hz)"
    depends on WAVESHARE_HW_I2C_ENABLE
    range 10000 1000000
    default 100000

config WAVESHARE_HW_I2C_TIMEOUT_MS
    int "Hardware I2C timeout (ms)"
    depends on WAVESHARE_HW_I2C_ENABLE
    range 10 5000
    default 500

config WAVESHARE_HW_TCA9555_ENABLE
    bool "Enable TCA9555 IO expander"
    depends on WAVESHARE_HW_I2C_ENABLE
    default y

config WAVESHARE_HW_TCA9555_ADDRESS
    hex "TCA9555 I2C address"
    depends on WAVESHARE_HW_TCA9555_ENABLE
    range 0x20 0x27
    default 0x20

config WAVESHARE_HW_AUDIO_PA_ACTIVE_HIGH
    bool "PA enable signal is active high"
    depends on WAVESHARE_HW_TCA9555_ENABLE
    default y

config WAVESHARE_HW_AUDIO_PA_DEFAULT_ON
    bool "Enable PA during hardware init"
    depends on WAVESHARE_HW_TCA9555_ENABLE
    default n

config WAVESHARE_HW_SD_CARD_DETECT_ACTIVE_LOW
    bool "SD card detect signal is active low"
    depends on WAVESHARE_HW_TCA9555_ENABLE
    default y

config WAVESHARE_HW_KEYS_ACTIVE_LOW
    bool "Board keys are active low"
    depends on WAVESHARE_HW_TCA9555_ENABLE
    default y

endmenu

config WAVESHARE_WIFI_ENABLE
    bool "Enable Wi-Fi station runtime"
    default y

config WAVESHARE_WIFI_SSID
    string "Wi-Fi SSID"
    depends on WAVESHARE_WIFI_ENABLE
    default ""

config WAVESHARE_WIFI_PASSWORD
    string "Wi-Fi password"
    depends on WAVESHARE_WIFI_ENABLE
    default ""

config WAVESHARE_WIFI_MAXIMUM_RETRY
    int "Wi-Fi reconnect attempts"
    depends on WAVESHARE_WIFI_ENABLE
    range 1 20
    default 5

config WAVESHARE_WIFI_CONNECT_TIMEOUT_MS
    int "Wi-Fi connect timeout (ms)"
    depends on WAVESHARE_WIFI_ENABLE
    range 1000 60000
    default 15000

config WAVESHARE_SDCARD_ENABLE
    bool "Enable SD card runtime"
    default y

config WAVESHARE_SDCARD_MOUNT_POINT
    string "SD card mount point"
    depends on WAVESHARE_SDCARD_ENABLE
    default "/sdcard"

config WAVESHARE_SDCARD_USE_SDMMC
    bool "Use SDMMC mode for SD card"
    depends on WAVESHARE_SDCARD_ENABLE
    default y

config WAVESHARE_SDCARD_SDMMC_SLOT
    int "SDMMC slot index"
    depends on WAVESHARE_SDCARD_ENABLE
    range 0 1
    default 0

config WAVESHARE_SDCARD_PIN_CLK
    int "SD card CLK pin"
    depends on WAVESHARE_SDCARD_ENABLE
    range 0 48
    default WAVESHARE_BOARD_SDMMC_CLK_GPIO

config WAVESHARE_SDCARD_PIN_D0
    int "SD card D0 pin"
    depends on WAVESHARE_SDCARD_ENABLE
    range 0 48
    default WAVESHARE_BOARD_SDMMC_D0_GPIO

config WAVESHARE_SDCARD_PIN_CMD
    int "SD card CMD pin"
    depends on WAVESHARE_SDCARD_ENABLE
    range 0 48
    default WAVESHARE_BOARD_SDMMC_CMD_GPIO

config WAVESHARE_SDCARD_FORMAT_IF_MOUNT_FAILED
    bool "Format SD card if mount fails"
    depends on WAVESHARE_SDCARD_ENABLE
    default n

config WAVESHARE_HTTP_FILE_SERVER_ENABLE
    bool "Enable SD Card HTTP File Server"
    depends on WAVESHARE_WIFI_ENABLE && WAVESHARE_SDCARD_ENABLE
    default y
    help
        Enables an embedded HTTP server providing CRUD operations and a Web Dashboard
        for files on the SD card over the local network.

config WAVESHARE_HTTP_FILE_SERVER_PORT
    int "HTTP file server port"
    depends on WAVESHARE_HTTP_FILE_SERVER_ENABLE
    range 1 65535
    default 80
    help
        Port number for the HTTP file server and Web Dashboard.

config WAVESHARE_HTTP_FILE_SERVER_BASE_PATH
    string "HTTP file server base mount path"
    depends on WAVESHARE_HTTP_FILE_SERVER_ENABLE
    default "/sdcard"
    help
        Base mount path on the local filesystem exposed via HTTP.

menu "Wake Word Detection"

config WAVESHARE_WAKEWORD_ENABLE
    bool "Enable Wake Word Detection service"
    default n

config WAVESHARE_WAKEWORD_MODEL_NAME
    string "Wake Word model name (e.g. 'hi_esp')"
    depends on WAVESHARE_WAKEWORD_ENABLE
    default "hi_esp"

config WAVESHARE_WAKEWORD_THRESHOLD
    float "Wake Word detection threshold"
    depends on WAVESHARE_WAKEWORD_ENABLE
    range 0 1
    default 0.7

endmenu

menu "Voice Assistant Backend Configuration"

    choice VOICE_BACKEND_SELECTION
        prompt "Active Voice Backend"
        default VOICE_BACKEND_RTP
        help
            Select the underlying voice transmission framework.
            Selecting Gemini Live will compile direct edge-to-cloud connections, 
            while RTP compiles the legacy proxy-based streamer and receiver.

        config VOICE_BACKEND_RTP
            bool "Legacy RTP Streamer/Receiver Proxy"
            help
                Streams audio to an intermediate local relay proxy server using raw UDP.

        config VOICE_BACKEND_GEMINI_LIVE
            bool "Standalone Gemini Live Direct Integration"
            select ESP_WEBSOCKET_CLIENT
            help
                Establishes direct secure WebSockets connection to Google AI Studio.
    endchoice

    config GEMINI_API_KEY
        string "Gemini API Key"
        depends on VOICE_BACKEND_GEMINI_LIVE
        default ""
        help
            Enter your Google AI Studio Gemini API Key.

endmenu

menu "Waveshare SPI Display and Touch Configuration"

config DISPLAY_ENABLE
    bool "Enable SPI Display (ILI9341)"
    default y
    help
        Enables the on-board SPI display using ILI9341 panel driver and LVGL v9.

config DISPLAY_WIDTH
    int "Display Width (pixels)"
    depends on DISPLAY_ENABLE
    default 320

config DISPLAY_HEIGHT
    int "Display Height (pixels)"
    depends on DISPLAY_ENABLE
    default 240

config DISPLAY_SPI_HOST
    int "SPI Host Controller (2=SPI2/FSPI, 3=SPI3/HSPI)"
    depends on DISPLAY_ENABLE
    range 2 3
    default 2

config DISPLAY_SCLK_PIN
    int "SPI Clock (SCLK) GPIO"
    depends on DISPLAY_ENABLE
    range 0 48
    default 4

config DISPLAY_MOSI_PIN
    int "SPI MOSI GPIO"
    depends on DISPLAY_ENABLE
    range 0 48
    default 9

config DISPLAY_MISO_PIN
    int "SPI MISO GPIO"
    depends on DISPLAY_ENABLE
    range -1 48
    default 8

config DISPLAY_CS_PIN
    int "Display Chip Select (CS) GPIO"
    depends on DISPLAY_ENABLE
    range 0 48
    default 3

config DISPLAY_DC_PIN
    int "Display Data/Command (DC) GPIO"
    depends on DISPLAY_ENABLE
    range 0 48
    default 7

config DISPLAY_RST_PIN
    int "Display Reset (RST) GPIO (-1 if tied to 3.3V/EN)"
    depends on DISPLAY_ENABLE
    range -1 48
    default -1

config DISPLAY_BL_PIN
    int "Display Backlight (BL) GPIO (-1 if tied to 3.3V)"
    depends on DISPLAY_ENABLE
    range -1 48
    default 5

config TOUCH_ENABLE
    bool "Enable XPT2046 SPI Touch Controller"
    depends on DISPLAY_ENABLE
    default y
    help
        Enables SPI touch input using XPT2046 controller on the same SPI bus.

config TOUCH_CS_PIN
    int "Touch Chip Select (CS) GPIO"
    depends on TOUCH_ENABLE
    range 0 48
    default 1

config TOUCH_IRQ_PIN
    int "Touch Interrupt (PENIRQ) GPIO (-1 for polling)"
    depends on TOUCH_ENABLE
    range -1 48
    default 2

endmenu

endmenu
```
